/*
 * LCD_display.c
 *
 *  Created on: 29Jan.,2020
 *      Author: jingchen
 */


#include "LCD_display.h"


pfCharacterFont_t  pfCharacterFont;
int16_t    width, height, rawWidth, rawHeight, printfX, printfY;
int16_t    textColor;
int16_t    textBackground;
uint8_t    textSize,textWidth,textHeight;
int16_t    cursorX, cursorY;
uint16_t   displayRadius;
uint16_t   lineWidth;

extern uint16_t LCD_buff[128*128];

const uint8_t table_character_6_8[][6] = {
{0x00,0x00,0x00,0x00,0x00,0x00},//space
{0x00,0x00,0x5F,0x00,0x00,0x00},//!
{0x00,0x07,0x00,0x07,0x00,0x00},//"
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{0x00,0x00,0x00,0x00,0x00,0x00}
};


static int16_t drawText(int16_t* pX, int16_t*  pY, const char* ch);
static void write1(const char* pCh);
static void drawVLine1(int16_t x, int16_t y, int16_t height_, uint16_t color);
static void drawHLine1(int16_t x, int16_t y, int16_t width_, uint16_t color);
static int16_t  Character_getCharacter(uint8_t* pCh, uint8_t* pBuf, uint8_t* pWidth, uint8_t* pHeight);
static void  drawPixel(uint16_t x, uint16_t y, uint16_t color);
static void fillRect1(int16_t x, int16_t y, int16_t width, int16_t height, uint16_t color);
static void draw_buffer1(int16_t x, int16_t y, int16_t x0, int16_t y0, uint16_t color);
static void drawVLine(int16_t x, int16_t y, int16_t height_, uint16_t color);

/******display area with width & height, initialize character_table buff ******/
void Display(uint16_t width_, uint16_t height_)
{

  width = width_ - 1;
  height = height_ - 1;
  rawWidth = width - 1;
  rawHeight = height - 1;
  textSize = 1;
  pfCharacterFont = Character_getCharacter;
  lineWidth = 1;
}



/*set the start point of display area x,y*/
void setCursor(int16_t x, int16_t y)
{
  if(x > width) {
    printfX = width;
  } else {
    printfX = x;
  }
  if(y > height) {
    printfY = height;
  } else {
    printfY = y;
  }
}

void setTextSize(uint8_t size)//uint16_t width,uint16_t height)
{
  textSize = size;
}

void setTextBackground(uint16_t color)
{
  textBackground = color;
}

void setTextColor(uint16_t color)
{
  textColor = color;
}



void print1(const char str[])
{
   write1(str);
}

/***********************testing code*******************/
uint16_t getLineWidth()
{
  return lineWidth;
}


void setLineWidth(uint16_t w)
{
  lineWidth = w;
}


/*get the character buff into temp buf, defult setting textwidth=6, textheigh=8  */
static int16_t Character_getCharacter(uint8_t *pCh, uint8_t* pBuf, uint8_t* pWidth, uint8_t* pHeight)
{
  uint8_t        var1 = 0;
  if(*pCh < 0x20) {
    if(*pCh > 0x06 && *pCh < 0x0e) {
      *pWidth = 6; *pHeight = 8;
      return 1;
    } else {
      return DISPLAY_ERR_PARAM;
    }
  //utf-8 code
  } else if(*pCh < 0x80) {
	  for(var1 = 0; var1 < 6; var1 ++) {
      pBuf[var1] = table_character_6_8[*pCh - 0x20][var1];

	  }
	  *pWidth = 6; *pHeight = 8;
	  return 1;
  } else {
    return DISPLAY_ERR_PARAM;
  }
}


/*****print *pCh string, call the cursor parameters*************/
static void write1(const char* pCh)
{
  drawText(&printfX, &printfY, pCh);
}

/*****using character table to draw char_string*************/
static int16_t drawText(int16_t* pX, int16_t* pY, const char* ch)
{
  uint8_t       characterBuffer[32] = {0};
  uint8_t       rslt = 0;
  uint8_t       i = 0, j = 0, k = 0;
  uint8_t       var1 = 0;

  while(*ch) {
    //get character
   rslt = pfCharacterFont((uint8_t*) ch, characterBuffer, &textWidth, &textHeight);
  // fillRect1(*pX - cursorX, *pY - cursorY, textWidth * textSize, textHeight * textSize, textBackground);

    if(rslt < 0) {
      return rslt;
    } else {
      if(*ch > 0x06 && *ch < 0x0e) {
        if(*ch == '\n') {
          *pX = 0;
          *pY += textHeight * textSize;
        }
        ch += rslt;
        continue;
      }
      ch += rslt;
      //check range
      if(*pX > rawWidth - textWidth * textSize) {
        *pX = 0;
        *pY += textHeight * textSize;
      }
      if(*pY > rawHeight - textHeight * textSize) {
        return -2;
      }
      if(rslt > 1) {
        /*display, charater example:
          data: 0xf0, 0x0f, 0x55, 0xaa ...
          display pixel: ****0000 0000****
                         0*0*0*0* *0*0*0*0
        */
        for(i = 0; i < 32; i ++) {
          var1 = characterBuffer[i];
          for(j = 0; j < 8; j ++) {
            if(var1 & (0x01 << j)) {
              for(k = 0; k < textSize; k ++) {
                drawVLine1(*pX + (i % 2) * 8 * textSize + j * textSize + k - cursorX,
                          *pY + (i / 2) * textSize - cursorY, textSize , textColor);
              }
            }
          }
        }
      } else {
        /*display, charater example:
          data: 0xf0, 0x0f, 0x55, 0xaa ...
          display pixel: ****0000
                         0000****
                         0*0*0*0*
                         *0*0*0*0
        */
        //8 * 16 text size
        if(textHeight == 16) {
          for(i = 0; i < 16; i ++) {
            var1 = characterBuffer[i];
            for(j = 0; j < 8; j ++) {
              if(var1 & (0x01 << j)) {
                for(k = 0; k < textSize; k ++) {
                  drawVLine1(*pX + j * textSize + k - cursorX,
                            *pY + i * textSize - cursorY, textSize , textColor);
                }
              }
            }
          }
        //6 * 8 text size
        } else {
          for(i = 0; i < textWidth; i ++) {
            var1 = characterBuffer[i];
            for(j = 0; j < 8; j ++) {
              if(var1 & (0x01 << j)) {
                for(k = 0; k < textSize; k ++) {
                 drawVLine1(*pX + i * textSize + k - cursorX, *pY + j * textSize - cursorY, textSize, textColor);

                }
              }
            }
          }
        }
      }
    }
    *pX += textWidth * textSize;
  }
}


static void drawVLine1(int16_t x, int16_t y, int16_t height_, uint16_t color)
{
  if((x + cursorX < 0) || (x + cursorX > width)) {return;}
  int8_t        direction = 1;
  int16_t       var1 = y + height_;
  if(height_ < 0) {
    direction = -1;
  }
  for(; y != var1; y += direction) {
    drawPixel(x, y, color);
  }
}

static void drawHLine1(int16_t x, int16_t y, int16_t width_, uint16_t color)
{
  if((y + cursorY < 0) || (y + cursorY > height)) {return;}
  int8_t        direction = 1;
  int16_t       var1 = x + width_;
  if(width_ < 0) {
    direction = -1;
  }
  for(; x != var1; x += direction) {
    drawPixel(x, y, color);
  }
}

static void  drawPixel(uint16_t x, uint16_t y, uint16_t color)
{

   // uint8_t colorBuf[2] = {color >> 8, color};
  //setCursorAddr(x, y, x, y);
  //writeCmd(0x2c);
  //writeDatBytes(colorBuf, 2);
  LCD_buff[y*128+x]=0x00F8;
}




static void fillRect1(int16_t x, int16_t y, int16_t width, int16_t height, uint16_t color)
{
  int8_t        directionX = 1;
  int16_t       var1 = x + width;
  if(width < 0)  { directionX = -1; }
  for(; x != var1; x += directionX)
  {
	drawVLine(x, y, height, color);
  }
}


static void drawVLine(int16_t x, int16_t y, int16_t height_, uint16_t color)
{

  if(height_<=0) {height_=-height_;}
  draw_buffer1(x,y, x, y + height_-1,color);// - 1
}

static void draw_buffer1(int16_t x, int16_t y, int16_t x0, int16_t y0, uint16_t color)
{

	for(int j = y; j <= y0; j++)
			{
			 for(int i = x; i <=x0; i ++)                    //x->increase first
				{
				  LCD_buff[j*128+i]=color;
				// drawPixel(x, y, color);
				}
			}
}
